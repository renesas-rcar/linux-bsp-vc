// SPDX-License-Identifier: GPL-2.0
/*
 * Device Tree Source for the VC4 vehicle computer board
 * For V1 schematics, as of 2021-07-13
 *
 * Copyright (C) 2021-2023 Renesas Electronics Corp.
 */

#include "r8a779f0-vc4.dts"

/* SDHI_PWR_SEL is at GPIO4_05 - n/a without control domain access */

&vccq_sdhi {
	status = "disabled";
};

&mmc0 {
	vqmcc-supply = <&vcc_sdhi>;
};
