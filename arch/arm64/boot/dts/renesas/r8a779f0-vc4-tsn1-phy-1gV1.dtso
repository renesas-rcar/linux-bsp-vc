/dts-v1/;
/plugin/;

#include <dt-bindings/gpio/gpio.h>

&gpio4 {
	tsn1-mux {
		gpio-hog;
		gpios = <7 GPIO_ACTIVE_HIGH>;
		output-high;
		line-name = "TSN1-MUX";
	};
};

&tsn1 {
	phy-handle = <&tsn1_phy_1g>;
};

&tsn1_phy_1g {
	status = "okay";
};
