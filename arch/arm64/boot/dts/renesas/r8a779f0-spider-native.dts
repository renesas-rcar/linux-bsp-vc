// SPDX-License-Identifier: (GPL-2.0 or MIT)
/*
 * Device Tree Source support Native device
 * for the Spider CPU and Breakout boards
 *
 * Copyright (C) 2022 Renesas Electronics Corp.
 */

/dts-v1/;
#include "r8a779f0-spider.dts"
#include "r8a779f0-native.dtsi"

/ {
	model = "Renesas Spider Native driver based on r8a779f0";
};
